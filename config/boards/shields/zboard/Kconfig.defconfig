## config/boards/shields/zboard/Kconfig.defconfig
```kconfig
# Copyright (c) 2020 The ZMK Contributors
# SPDX-License-Identifier: MIT

if SHIELD_ZBOARD_RIGHT

config ZMK_KEYBOARD_NAME
	default "Zdmk"

config ZMK_SPLIT_BLE_ROLE_CENTRAL
	default y

config ZMK_SPLIT_ROLE_CENTRAL
	default y

endif

if SHIELD_ZBOARD_LEFT || SHIELD_ZBOARD_RIGHT

config ZMK_SPLIT
	default y

endif
```
